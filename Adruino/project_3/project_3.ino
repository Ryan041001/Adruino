#include <SPI.h>
#include <Wire.h>
#include <Adafruit_GFX.h>
#include <Adafruit_SSD1306.h>

// OLED显示屏设置 - 修改为I2C接口
#define SCREEN_WIDTH 128    // OLED显示宽度，单位：像素
#define SCREEN_HEIGHT 64    // OLED显示高度，单位：像素
#define OLED_RESET     -1   // Reset pin # (或 -1 if sharing Arduino reset pin)
Adafruit_SSD1306 display(SCREEN_WIDTH, SCREEN_HEIGHT, &Wire, OLED_RESET);

// 超声波模块引脚定义
#define TRIG_PIN 2   
#define ECHO_PIN 7   
#define BUZZER_PIN 8

// 按钮引脚定义
#define BTN_UP 4
#define BTN_DOWN 5  
#define BTN_SELECT 6

// 全局变量
float distance = 0;
int alarmThreshold = 20; // 默认报警距离阈值(cm)
int menuPosition = 0;    // 菜单位置
bool inMenu = false;     // 是否在菜单中
unsigned long lastMeasureTime = 0;
unsigned long lastButtonCheckTime = 0;
bool btnUpState = HIGH;
bool btnDownState = HIGH;  // 添加DOWN按钮状态
bool btnSelectState = HIGH;
bool lastBtnUpState = HIGH;
bool lastBtnDownState = HIGH;  // 添加DOWN按钮上一次状态
bool lastBtnSelectState = HIGH;

// 浙江工商大学logo位图数据
const unsigned char ZJSU_LOGO [] PROGMEM = {
  0xff, 0xff, 0xff, 0xff, 0xff, 0xff, 0xff, 0xff, 0xff, 0xff, 0xff, 0xff, 0xff, 0xff, 0xff, 0xff, 
	0xff, 0xff, 0xff, 0xff, 0xff, 0xff, 0xff, 0xff, 0xff, 0xff, 0xff, 0xff, 0xff, 0xff, 0xff, 0xff, 
	0xff, 0xff, 0xff, 0xff, 0xff, 0xff, 0xff, 0xc9, 0x27, 0xff, 0xff, 0xff, 0xff, 0xff, 0xff, 0xff, 
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	0xff, 0xff, 0xff, 0xff, 0xff, 0xff, 0xff, 0xff, 0xff, 0xff, 0xff, 0xff, 0xff, 0xff, 0xff, 0xff
};

void setup() {
  // 初始化串口通信
  Serial.begin(9600);
  
  // 初始化OLED显示屏 - 修改初始化方式
  if(!display.begin(SSD1306_SWITCHCAPVCC, 0x3C)) {
    Serial.println(F("SSD1306初始化失败"));
    for(;;); // 无限循环
  }
  
  //初始化引脚
  pinMode(TRIG_PIN, OUTPUT);
  pinMode(ECHO_PIN, INPUT);
  pinMode(BUZZER_PIN, OUTPUT);
  pinMode(BTN_UP, INPUT_PULLUP);
  pinMode(BTN_DOWN, INPUT_PULLUP);  // 初始化DOWN按钮
  pinMode(BTN_SELECT, INPUT_PULLUP);
  
  // 显示开机画面
  showSplashScreen();  // 这里不需要额外的delay，因为已经在函数内部处理了
}

void loop() {
  // 检查按钮状态
  checkButtons();
  
  // 测量距离
  if (millis() - lastMeasureTime > 200) { // 每200ms测量一次
    distance = measureDistance();
    lastMeasureTime = millis();
    
    // 检查是否需要报警
    if (distance < alarmThreshold && distance > 0) {
      tone(BUZZER_PIN, 1000, 100); // 发出报警声
    } else {
      noTone(BUZZER_PIN);
    }
  }
  
  // 更新显示
  if (inMenu) {
    showMenu();
  } else {
    showDistance();
  }
  
  delay(50); // 短暂延迟以稳定系统
}

// 显示开机画面
void showSplashScreen() {
  // 先显示校徽3秒
  display.clearDisplay();
  display.drawBitmap(0, 0, ZJSU_LOGO, 128, 64, WHITE);  // 修改为全屏显示
  display.display();
  delay(3000);
  
  // 再显示姓名和学号3秒
  display.clearDisplay();
  display.setTextSize(1);
  display.setTextColor(WHITE);
  
  // 居中显示姓名和学号
  display.setCursor(20, 20);
  display.println(F("wangyong"));
  display.setCursor(20, 30);
  display.println(F("2312190301"));
  
  display.setCursor(20, 40);
  display.println(F("shenzhewei"));
  display.setCursor(20, 50);
  display.println(F("2312190313"));
  
  display.display();
  delay(3000);
}

// 测量距离
float measureDistance() {
  // 发送超声波脉冲
  digitalWrite(TRIG_PIN, LOW);
  delayMicroseconds(2);
  digitalWrite(TRIG_PIN, HIGH);
  delayMicroseconds(10);
  digitalWrite(TRIG_PIN, LOW);
  
  // 读取回波时间
  long duration = pulseIn(ECHO_PIN, HIGH);
  
  // 计算距离 (声速 = 343m/s = 0.0343cm/us)
  float dist = duration * 0.0343 / 2;
  
  // 限制测量范围
  if (dist > 400) {
    dist = 0; // 超出范围
  }
  
  return dist;
}

// 显示距离
void showDistance() {
  display.clearDisplay();
  
  // 标题
  display.setTextSize(1);
  display.setTextColor(WHITE);
  display.setCursor(0, 0);
  display.println(F("Distance Measurement"));
  
  // 绘制分隔线
  display.drawLine(0, 10, display.width(), 10, WHITE);
  
  // 显示当前距离
  display.setTextSize(2);
  display.setCursor(10, 20);
  
  if (distance > 0) {
    display.print(distance, 1);
    display.println(F(" cm"));
  } else {
    display.println(F("Out of range"));
  }
  
  // 显示报警阈值
  display.setTextSize(1);
  display.setCursor(0, 45);
  display.print(F("Alarm: <"));
  display.print(alarmThreshold);
  display.println(F(" cm"));
  
  // 显示操作提示
  display.setCursor(0, 55);
  display.println(F("Press SELECT for menu"));
  
  display.display();
}

// 显示菜单
void showMenu() {
  display.clearDisplay();
  
  // 菜单标题
  display.setTextSize(1);
  display.setTextColor(WHITE);
  display.setCursor(30, 0);
  display.println(F("MENU"));
  
  // 绘制分隔线
  display.drawLine(0, 10, display.width(), 10, WHITE);
  
  // 菜单选项
  display.setCursor(10, 20);
  display.print(menuPosition == 0 ? F("> ") : F("  "));
  display.println(F("Set Alarm Threshold"));
  
  display.setCursor(10, 30);
  display.print(menuPosition == 1 ? F("> ") : F("  "));
  display.println(F("Exit Menu"));
  
  // 如果在设置报警阈值
  if (menuPosition == 0) {
    display.setCursor(10, 45);
    display.print(F("Current: "));
    display.print(alarmThreshold);
    display.println(F(" cm"));
    display.setCursor(10, 55);
    display.println(F("UP/DOWN to change"));  // 修改提示文本
  }
  
  display.display();
}

// 检查按钮状态
void checkButtons() {
  if (millis() - lastButtonCheckTime < 50) { // 防抖
    return;
  }
  
  btnUpState = digitalRead(BTN_UP);
  btnDownState = digitalRead(BTN_DOWN);  // 读取DOWN按钮状态
  btnSelectState = digitalRead(BTN_SELECT);
  
  // 检测SELECT按钮按下
  if (btnSelectState == LOW && lastBtnSelectState == HIGH) {
    if (!inMenu) {
      inMenu = true;
      menuPosition = 0;
    } else if (menuPosition == 1) {
      inMenu = false;
    } else if (menuPosition == 0) {
      // 在设置报警阈值时，SELECT按钮确认并返回主菜单
      menuPosition = 1;
    }
  }
  
  // 检测UP按钮按下
  if (btnUpState == LOW && lastBtnUpState == HIGH) {
    if (inMenu) {
      if (menuPosition == 0) {
        // 在设置报警阈值时，UP按钮增加阈值
        alarmThreshold += 5;
        if (alarmThreshold > 200) alarmThreshold = 200;
      } else {
        // 在菜单选择时，UP按钮切换到上一个菜单项
        menuPosition = 0;
      }
    }
  }
  
  // 检测DOWN按钮按下
  if (btnDownState == LOW && lastBtnDownState == HIGH) {
    if (inMenu) {
      if (menuPosition == 0) {
        // 在设置报警阈值时，DOWN按钮减小阈值
        alarmThreshold -= 5;
        if (alarmThreshold < 5) alarmThreshold = 5;
      } else {
        // 在菜单选择时，DOWN按钮切换到下一个菜单项
        menuPosition = 1;
      }
    }
  }
  
  lastBtnUpState = btnUpState;
  lastBtnDownState = btnDownState;  // 更新DOWN按钮上一次状态
  lastBtnSelectState = btnSelectState;
  lastButtonCheckTime = millis();
}
